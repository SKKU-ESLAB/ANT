## Kconfig
```kconfig
mainmenu "ANT Framework Configuration"

# Target boards' type
choice
  prompt "Target Board Type"
  default TARGET_RASPBERRY_PI_3
  help
    Target board type decides which device driver it uses

config TARGET_RASPBERRY_PI_2
  bool "Raspberry Pi 2"
  help
    Build ANT for Raspberry Pi 2

config TARGET_RASPBERRY_PI_3
  bool "Raspberry Pi 3"
  help
    Build ANT for Raspberry Pi 3

config TARGET_TEGRA_TX1
  bool "Tegra TX1"
  help
    Build ANT for Tegra TX1

config TARGET_TEGRA_TX2
  bool "Tegra TX2"
  help
    Build ANT for Tegra TX2

config TARGET_ODROID_XU3
  bool "ODROID XU3"
  help
    Build ANT for ODROID XU3

config TARGET_ODROID_XU4
  bool "ODROID XU4"
  help
    Build ANT for ODROID XU4

config TARGET_OTHER
  bool "Other Device"
  help
    Build ANT for other devices with virtual device drivers

endchoice

# Target device profile
# TODO: configurable WFD support
choice
  prompt "Target Profile"
  default PROFILE_CAMERA_BASED_SENSOR_DEVICE

  config PROFILE_NORMAL_SENSOR_DEVICE
    bool "Normal Sensor Device"
    select SENSOR_FW
    select COMM_FW
    select COMM_BT_SUPPORT
    select COMM_WFD_SUPPORT
    help
      Sensor device with several sensors

  config PROFILE_CAMERA_BASED_SENSOR_DEVICE
    bool "Camera-based Sensor Device"
    select SENSOR_FW
    select CAMERA_FW
    select COMM_FW
    select COMM_BT_SUPPORT
    select COMM_WFD_SUPPORT
    help
      Sensor device with several sensors and cameras

  config PROFILE_GATEWAY_DEVICE
    bool "Gateway Device"
    select GATEWAY_FW
    select COMM_FW
    select COMM_BT_SUPPORT
    select COMM_WFD_SUPPORT
    help
      Gateway device without any sensors or cameras
endchoice

source "framework/Kconfig"

menu "JavaScript APIs"
  source "api/Kconfig"
  source "new-api/Kconfig"
endmenu

source "apps/Kconfig"

source "models/Kconfig"
```

## api/Kconfig
```kconfig
config SENSOR_JS_API
  bool "Sensor API"
  depends on SENSOR_FW
  default y if SENSOR_FW
  help
    JavaScript-based Sensor API

config CAMERA_JS_API
  bool "Camera API"
  depends on CAMERA_FW
  default y if CAMERA_FW
  help
    JavaScript-based Camera API

config CLOUD_JS_API
  bool "Cloud API"
  default n
  help
    JavaScript-based Cloud API

menuconfig CLOUD_PLUGIN
  bool "Cloud Plug-ins"
  depends on CLOUD_JS_API
  default n
  help
    JavaScript-based Cloud Plug-ins

if CLOUD_PLUGIN
config GOOGLE_CLOUD_PLUGIN
  bool "Google Cloud Plug-in"
  depends on CLOUD_JS_API
  default y if CLOUD_PLUGIN=y
  help
    JavaScript-based Google Cloud Plug-in

endif # CLOUD_PLUGIN
```

## apps/sample/Kconfig
```kconfig
menu "Sample Applications"

config MACHINE_LEARNING_SAMPLE_APP
  bool "Machine Learning Sample"
  depends on ML_JS_API
  depends on CAMERA_JS_API
  help
    Machine Learning Sample App

config QUICK_CAM_SAMPLE_APP
  bool "Quick Camera Sample"
  depends on SENSOR_JS_API
  depends on CAMERA_JS_API
  depends on REMOTE_UI_JS_API
  help
    QuickCam (Quick Camera) Sample App

config REMOTE_UI_SAMPLE_APP
  bool "Remote UI Sample"
  depends on REMOTE_UI_JS_API
  help
    Remote UI Sample App

endmenu
```

## apps/system/Kconfig
```kconfig
menu "System Applications"

config CAMERA_VIEWER_SYSTEM_APP
  bool "Camera Viewer"
  depends on CAMERA_JS_API
  default y if CAMERA_JS_API
  help
    Camera Viewer App

config SENSOR_VIEWER_SYSTEM_APP
  bool "Sensor Viewer"
  depends on SENSOR_JS_API
  depends on COMM_JS_API
  default y if (SENSOR_JS_API && COMM_JS_API)
  help
    Sensor Viewer App

config IMAGE_CLASSIFIER_SYSTEM_APP
  bool "Image Classifier"
  depends on ML_JS_API
  depends on CAMERA_JS_API
  default y if (ML_JS_API && CAMERA_JS_API)
  select SQUEEZENET_DNN_MODEL
  help
    Image Classifier App based on CNN

config MOTION_CLASSIFIER_SYSTEM_APP
  bool "Motion Classifier"
  depends on ML_JS_API
  depends on SENSOR_JS_API
  depends on COMM_JS_API
  default y if (ML_JS_API && SENSOR_JS_API && COMM_JS_API)
  select MOTION_CLASSIFIER_ANN_MODEL
  help
    Motion Classifier App based on ANN

config TEST_APP
  bool "Test App"
  default y
  help
    Test App

endmenu
```

## framework/Kconfig
```kconfig
config SENSOR_FW
  bool "Sensor Framework"
  help
    Sensor Framework

config CAMERA_FW
  bool "Camera Framework"
  help
    Camera Framework

config ML_FW
  bool "Machine Learning Framework"
  default y if (PROFILE_CAMERA_BASED_SENSOR_DEVICE || PROFILE_GATEWAY_DEVICE)
  help
    Machine Learning Framework

config GATEWAY_FW
  bool "Gateway Framework"
  help
    Gateway Framework

menuconfig COMM_FW
  bool "Communication Library (libant-cmfw)"
  default y
  help
    Communication Library is a library to make connection and data transfer between target device and companion device.

if COMM_FW
config COMM_BT_SUPPORT
  bool "Bluetooth Support"
  default y
  help
    Enable Bluetooth Support of Communication Library

config COMM_WFD_SUPPORT
  bool "Wi-fi Direct Support"
  default y if (PROFILE_CAMERA_BASED_SENSOR_DEVICE || PROFILE_GATEWAY_DEVICE)
  help
    Enable Wi-fi Direct Support of Communication Library
endif
```

## models/Kconfig
```kconfig
menu "Built-in Machine Learning Models"
  depends on ML_FW

config SQUEEZENET_DNN_MODEL
  bool "SqueezeNet Model (DNN/Caffe)"
  help
    DNN-based SqueezeNet Model (Caffe)

config MOTION_CLASSIFIER_ANN_MODEL
  bool "Motion Classifier Model (ANN)"
  help
    ANN-based Motion Classifier Model

endmenu
```

## new-api/Kconfig
```kconfig
config ML_JS_API
  bool "Machine Learning Inference API"
  depends on ML_FW
  default y if ML_FW
  help
    JavaScript-based Machine Learning Inference API

config COMM_JS_API
  bool "Communication API"
  depends on COMM_FW
  default y if COMM_FW
  help
    JavaScript-based Communication API to interact with companion devices

config REMOTE_UI_JS_API
  bool "Remote UI API"
  depends on COMM_JS_API
  default y if COMM_JS_API
  help
    JavaScript-based Remote UI API to display Remote UI on companion devices
```
